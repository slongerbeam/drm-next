## Documentation/devicetree/bindings/staging/imx-drm/fsl-imx-drm.txt
```
Freescale i.MX DRM master device
================================

The freescale i.MX DRM master device is a virtual device needed to list all
IPU or other display interface nodes that comprise the graphics subsystem.

Required properties:
- compatible: Should be "fsl,imx-display-subsystem"
- ports: Should contain a list of phandles pointing to display interface ports
  of IPU devices

example:

display-subsystem {
	compatible = "fsl,display-subsystem";
	ports = <&ipu_di0>;
};


Freescale i.MX IPUv3
====================

Required properties:
- compatible: Should be "fsl,<chip>-ipu"
- reg: should be register base and length as documented in the
  datasheet
- interrupts: Should contain sync interrupt and error interrupt,
  in this order.
- resets: phandle pointing to the system reset controller and
          reset line index, see reset/fsl,imx-src.txt for details
Optional properties:
- port@[0-3]: Port nodes with endpoint definitions as defined in
  Documentation/devicetree/bindings/media/video-interfaces.txt.
  Ports 0 and 1 should correspond to CSI0 and CSI1,
  ports 2 and 3 should correspond to DI0 and DI1, respectively.

example:

ipu: ipu@18000000 {
	#address-cells = <1>;
	#size-cells = <0>;
	compatible = "fsl,imx53-ipu";
	reg = <0x18000000 0x080000000>;
	interrupts = <11 10>;
	resets = <&src 2>;

	ipu_di0: port@2 {
		reg = <2>;

		ipu_di0_disp0: endpoint {
			remote-endpoint = <&display_in>;
		};
	};
};

Parallel display support
========================

Required properties:
- compatible: Should be "fsl,imx-parallel-display"
Optional properties:
- interface-pix-map: Defines a pixel mapping onto the 24-bit IPU
  Display Interface bus to the display. Internally the IPU represents
  pixels in either RGB24 or YUV444 format. This property tells the IPU how
  to map those RGB24 or YUV444 pixels onto the display interface bus.
  The data format is as follows:

  interface-pix-map = <c0-dest-msb c0-src-mask c1-dest-msb c1-src-mask
  		       c2-dest-msb c2-src-mask>;

  where:
	c0, c1, c2: are the color components (c0 = B/V, c1 = G/U, c2 = R/Y)
	src-mask: is the mask of component source bits to be forwarded
	          to the DI bus
	dest-msb: defines where to place those component bits on the
	          24-bit DI bus, represented as the MSBit on the bus.

- interface-pix-fmt: A name given to the pixel format sent to the display.
  The following are names with pre-defined pixel mappings that do not
  require an explicit interface-pix-map property: "rgb24", "rgb565", "rgb666"

- edid: verbatim EDID data block describing attached display.
- ddc: phandle describing the i2c bus handling the display data
  channel
- port: A port node with endpoint definitions as defined in
  Documentation/devicetree/bindings/media/video-interfaces.txt.

example:

display@di0 {
	compatible = "fsl,imx-parallel-display";
	edid = [edid-data];
	interface-pix-fmt = "rgb24";

	port {
		display_in: endpoint {
			remote-endpoint = <&ipu_di0_disp0>;
		};
	};
};

Pixel map examples:

This example defines a new format named "bgr565" using a pixel map:

display@di0 {
	compatible = "fsl,imx-parallel-display";
	edid = [edid-data];
	interface-pix-fmt = "bgr565";
	interface-pix-map = <15 0xf8 10 0xfc 4 0xf8>;
};

This example defines an unnamed format where an rgb666 format is shifted
up by 6 bits on the DI bus:

display@di0 {
	compatible = "fsl,imx-parallel-display";
	edid = [edid-data];
	interface-pix-map = <11 0xfc 17 0xfc 23 0xfc>;
};
```
